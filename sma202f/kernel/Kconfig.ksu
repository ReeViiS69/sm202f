## sma202f/kernel/Kconfig.ksu
```kconfig
menu "KSU SUSFS Configuration"

config KSU
    bool "Enable KSU core"
    default y

config KSU_WITH_KPROBES
    bool "Enable KSU with KProbes support"
    depends on KSU
    default n

config KSU_SUSFS
    bool "Enable KSU SUSFS"
    depends on KSU
    default y

config KSU_SUSFS_HAS_MAGIC_MOUNT
    bool "Support for magic mount path"
    depends on KSU_SUSFS
    default y

config KSU_SUSFS_SUS_PATH
    bool "Enable SUS path support"
    depends on KSU_SUSFS
    default y

config KSU_SUSFS_SUS_MOUNT
    bool "Enable SUS mount support"
    depends on KSU_SUSFS
    default y

config KSU_SUSFS_AUTO_ADD_SUS_KSU_DEFAULT_MOUNT
    bool "Auto add SUS KSU default mount"
    depends on KSU_SUSFS
    default y

config KSU_SUSFS_AUTO_ADD_SUS_BIND_MOUNT
    bool "Auto add SUS bind mount"
    depends on KSU_SUSFS
    default y

config KSU_SUSFS_SUS_KSTAT
    bool "Enable SUS kstat"
    depends on KSU_SUSFS
    default y

config KSU_SUSFS_SUS_OVERLAYFS
    bool "Enable SUS overlayfs"
    depends on KSU_SUSFS
    default n

config KSU_SUSFS_TRY_UMOUNT
    bool "Enable try umount support"
    depends on KSU_SUSFS
    default y

config KSU_SUSFS_AUTO_ADD_TRY_UMOUNT_FOR_BIND_MOUNT
    bool "Auto add try umount for bind mount"
    depends on KSU_SUSFS_TRY_UMOUNT
    default y

config KSU_SUSFS_SPOOF_UNAME
    bool "Enable uname spoofing"
    depends on KSU_SUSFS
    default y

config KSU_SUSFS_ENABLE_LOG
    bool "Enable SUSFS logging"
    depends on KSU_SUSFS
    default y

config KSU_SUSFS_HIDE_KSU_SUSFS_SYMBOLS
    bool "Hide SUSFS symbols"
    depends on KSU_SUSFS
    default y

config KSU_SUSFS_SPOOF_CMDLINE_OR_BOOTCONFIG
    bool "Spoof cmdline or bootconfig"
    depends on KSU_SUSFS
    default y

config KSU_SUSFS_OPEN_REDIRECT
    bool "Enable open redirect"
    depends on KSU_SUSFS
    default y

config KSU_SUSFS_SUS_SU
    bool "Enable SUS su"
    depends on KSU_SUSFS
    default n

endmenu
```
